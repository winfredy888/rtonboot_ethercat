## nuttx/arch/arm64/src/rk3568/Kconfig
```kconfig
#
# For a description of the syntax of this configuration file,
# see the file kconfig-language.txt in the NuttX tools repository.
#

if ARCH_CHIP_RK3568

menu "Rockchip RK3568 Peripheral Selection"

config RK3568_UART
	bool "UART 0"
	default n
	select UART0_SERIALDRIVER
	select ARCH_HAVE_SERIAL_TERMIOS
	---help---
		Select to enable support for UART0.

endmenu # Rockchip RK3568 Peripheral Selection

endif # ARCH_CHIP_RK3568
```

## nuttx/arch/arm64/src/rk3588/Kconfig
```kconfig
#
# For a description of the syntax of this configuration file,
# see the file kconfig-language.txt in the NuttX tools repository.
#

if ARCH_CHIP_RK3588

menu "Rockchip RK3588 Peripheral Selection"

config RK3588_UART
	bool "UART 0"
	default n
	select UART0_SERIALDRIVER
	select ARCH_HAVE_SERIAL_TERMIOS
	---help---
		Select to enable support for UART0.

endmenu # Rockchip RK3588 Peripheral Selection

endif # ARCH_CHIP_RK3588
```

## nuttx/boards/arm64/rk3588/rd3588/Kconfig
```kconfig
#
# For a description of the syntax of this configuration file,
# see the file kconfig-language.txt in the NuttX tools repository.
#

if ARCH_BOARD_RD3588

config ARCH_BOARD
	string "ARCH_BOARD"
	default "rd3588"
	---help---
		Specify ARCH_BOARD.
		
endif # ARCH_BOARD_RD3588
```

## nuttx/drivers/ethercat/Kconfig
```kconfig
#
# For a description of the syntax of this configuration file,
# see the file kconfig-language.txt in the NuttX tools repository.
#

menuconfig DRIVERS_ETHERCAT
	bool "IGH Ethercat Support"
	default n
	---help---
		Drivers for IGH Ethercat.

if DRIVERS_ETHERCAT

config ETHERCAT_MASTER
	bool "ETHERCAT_MASTER support"
	default n
	---help---
		Drivers for IGH Ethercat Master.
				
config ETHERCAT_stmmac
	bool "ETHERCAT stmmac device support"
	default n
	---help---
		Drivers for ETHERCAT stmmac device.		

endif # DRIVERS_ETHERCAT
```

## nuttx/libs/libethercat/Kconfig
```kconfig
#
# For a description of the syntax of this configuration file,
# see the file kconfig-language.txt in the NuttX tools repository.
#

menuconfig LIBETHERCAT
	bool "IGH Ethrecat Library"
	default n
	---help---
		Enable build for IGH Ethrecat functions
```

## nuttx/libs/libsoem/Kconfig
```kconfig
#
# For a description of the syntax of this configuration file,
# see the file kconfig-language.txt in the NuttX tools repository.
#

menuconfig LIBSOEM
	bool "SOEM Ethrecat Library"
	default n
	---help---
		Enable build for SOEM Ethrecat functions
```

## rd3588_buildroot/buildroot/configs/rockchip_rk3588_defconfig
```kconfig
#include "base/base.config"
#include "chips/rk3588_aarch64.config"
#include "font/chinese.config"
#include "fs/exfat.config"
#include "fs/ntfs.config"
#include "fs/vfat.config"
#include "gpu/gpu.config"
#include "multimedia/audio.config"
#include "multimedia/camera.config"
#include "multimedia/gst/audio.config"
#include "multimedia/gst/camera.config"
#include "multimedia/gst/rtsp.config"
#include "multimedia/gst/video.config"
#include "multimedia/mpp.config"
#include "wifibt/bt.config"
#include "wifibt/wireless.config"
#include "tools/benchmark.config"
#include "tools/common.config"
#include "tools/test.config"
#include "chromium.config"
#include "npu2.config"
#include "powermanager.config"
#include "weston.config"
#include "qt/qt5.config"
#include "qt/app.config"
BR2_ROOTFS_OVERLAY+="board/rockchip/rk3588/fs-overlay/"
BR2_PACKAGE_APP_RTONBOOT=y
BR2_PACKAGE_APP_TESTBC=y
BR2_PACKAGE_LIB_RTSDK=y
BR2_PACKAGE_APP_ECCRTL=y
BR2_PACKAGE_APP_EC_CYCLIC=y
BR2_PACKAGE_APP_EC_INTER=y
BR2_PACKAGE_APP_EC_INTER=y
BR2_PACKAGE_APP_SIMPLETEST=y
BR2_PACKAGE_APP_PRINTDBG=y
BR2_PACKAGE_APP_MOTORCTL=y
BR2_PACKAGE_APP_MOTORPP=y
BR2_PACKAGE_APP_MKPREACTIMG=y
BR2_PACKAGE_APP_RTETHCRTL=y
```

## rd3588_buildroot/buildroot/package/app-ec_cyclic/Config.in
```kconfig
config BR2_PACKAGE_APP_EC_CYCLIC
	bool "ec_cyclic"
	help
	  Winfred Young ec_cyclic command
	  
```

## rd3588_buildroot/buildroot/package/app-ec_inter/Config.in
```kconfig
config BR2_PACKAGE_APP_EC_INTER
	bool "ec_inter"
	help
	  Winfred Young ec_inter command
	  
```

## rd3588_buildroot/buildroot/package/app-eccrtl/Config.in
```kconfig
config BR2_PACKAGE_APP_ECCRTL
	bool "eccrtl"
	help
	  Winfred Young eccrtl command
	  
```

## rd3588_buildroot/buildroot/package/app-mkpreactimg/Config.in
```kconfig
config BR2_PACKAGE_APP_MKPREACTIMG
	bool "mkpreactimg"
	help
	  Winfred Young mkpreactimg command
	  
```

## rd3588_buildroot/buildroot/package/app-motorctl/Config.in
```kconfig
config BR2_PACKAGE_APP_MOTORCTL
	bool "motorctl"
	help
	  Winfred Young motorctl command
	  
```

## rd3588_buildroot/buildroot/package/app-motorpp/Config.in
```kconfig
config BR2_PACKAGE_APP_MOTORPP
	bool "motorpp"
	help
	  Winfred Young motorpp command
	  
```

## rd3588_buildroot/buildroot/package/app-printdbg/Config.in
```kconfig
config BR2_PACKAGE_APP_PRINTDBG
	bool "printdbg"
	help
	  Winfred Young printdbg command
	  
```

## rd3588_buildroot/buildroot/package/app-rtethcrtl/Config.in
```kconfig
config BR2_PACKAGE_APP_RTETHCRTL
	bool "rtethcrtl"
	help
	  Winfred Young rtethcrtl script
	  
```

## rd3588_buildroot/buildroot/package/app-rtonboot/Config.in
```kconfig
config BR2_PACKAGE_APP_RTONBOOT
	bool "rtonboot"
	help
	  Winfred Young rtonboot command
	  
```

## rd3588_buildroot/buildroot/package/app-simpletest/Config.in
```kconfig
config BR2_PACKAGE_APP_SIMPLETEST
	bool "simpletest"
	help
	  Winfred Young simpletest command
	  
```

## rd3588_buildroot/buildroot/package/app-testbc/Config.in
```kconfig
config BR2_PACKAGE_APP_TESTBC
	bool "testbc"
	help
	  Winfred Young testbc command
	  
```
