## apps/ethercat/ec_cyclic/Kconfig
```kconfig
#
# For a description of the syntax of this configuration file,
# see the file kconfig-language.txt in the NuttX tools repository.
#

config ETHERCAT_EC_CYCLIC
	tristate "IGH EC_CYCLIC Program"
	default n
	---help---
		IGH EC_CYCLIC Program

if ETHERCAT_EC_CYCLIC

config ETHERCAT_EC_CYCLIC_PROGNAME
	string "Program name"
	default "ec_cyclic"
	---help---
		This is the name of the program that will be used when the NSH ELF
		program is installed.

config ETHERCAT_EC_CYCLIC_PRIORITY
	int "IGH EC_CYCLIC Program task priority"
	default 128

config ETHERCAT_EC_CYCLIC_STACKSIZE
	int "IGH EC_CYCLIC Program stack size"
	default DEFAULT_TASK_STACKSIZE

endif
```

## apps/ethercat/ec_inter/Kconfig
```kconfig
#
# For a description of the syntax of this configuration file,
# see the file kconfig-language.txt in the NuttX tools repository.
#

config ETHERCAT_EC_INTER
	tristate "IGH EC_INTER Program"
	default n
	---help---
		IGH EC_INTER Program

if ETHERCAT_EC_INTER

config ETHERCAT_EC_INTER_PROGNAME
	string "Program name"
	default "ec_inter"
	---help---
		This is the name of the program that will be used when the NSH ELF
		program is installed.

config ETHERCAT_EC_INTER_PRIORITY
	int "IGH EC_INTER Program task priority"
	default 128

config ETHERCAT_EC_INTER_STACKSIZE
	int "IGH EC_INTER Program stack size"
	default DEFAULT_TASK_STACKSIZE

endif
```

## apps/ethercat/ethercat/Kconfig
```kconfig
#
# For a description of the syntax of this configuration file,
# see the file kconfig-language.txt in the NuttX tools repository.
#

config ETHERCAT_ETHERCAT
	tristate "IGH ETHERCAT Command"
	default n
	---help---
		IGH ETHERCAT Command

if ETHERCAT_ETHERCAT

config ETHERCAT_ETHERCAT_PROGNAME
	string "Program name"
	default "ethercat"
	---help---
		This is the name of the program that will be used when the NSH ELF
		program is installed.

config ETHERCAT_ETHERCAT_PRIORITY
	int "IGH ETHERCAT Command task priority"
	default 100

config ETHERCAT_ETHERCAT_STACKSIZE
	int "IGH ETHERCAT Command stack size"
	default DEFAULT_TASK_STACKSIZE

endif
```

## apps/ethercat/motorctl/Kconfig
```kconfig
#
# For a description of the syntax of this configuration file,
# see the file kconfig-language.txt in the NuttX tools repository.
#

config ETHERCAT_SOEM_MOTORCTL
	tristate "ETHERCAT SOEM MOTORCTL"
	default n
	---help---
		ETHERCAT SOEM MOTORCTL Program

if ETHERCAT_SOEM_MOTORCTL

config ETHERCAT_SOEM_MOTORCTL_PROGNAME
	string "Program name"
	default "motorctl"
	---help---
		This is the name of the program that will be used when the NSH ELF
		program is installed.

config ETHERCAT_SOEM_MOTORCTL_PRIORITY
	int "SOEM MOTORCTL Program task priority"
	default 128

config ETHERCAT_SOEM_MOTORCTL_STACKSIZE
	int "SOEM MOTORCTL Program stack size"
	default DEFAULT_TASK_STACKSIZE

endif
```

## apps/ethercat/motorpp/Kconfig
```kconfig
#
# For a description of the syntax of this configuration file,
# see the file kconfig-language.txt in the NuttX tools repository.
#

config ETHERCAT_SOEM_MOTORPP
	tristate "ETHERCAT SOEM MOTORPP"
	default n
	---help---
		ETHERCAT SOEM MOTORPP Program

if ETHERCAT_SOEM_MOTORPP

config ETHERCAT_SOEM_MOTORPP_PROGNAME
	string "Program name"
	default "motorpp"
	---help---
		This is the name of the program that will be used when the NSH ELF
		program is installed.

config ETHERCAT_SOEM_MOTORPP_PRIORITY
	int "SOEM MOTORPP Program task priority"
	default 128

config ETHERCAT_SOEM_MOTORPP_STACKSIZE
	int "SOEM MOTORPP Program stack size"
	default DEFAULT_TASK_STACKSIZE

endif
```

## apps/ethercat/simpletest/Kconfig
```kconfig
#
# For a description of the syntax of this configuration file,
# see the file kconfig-language.txt in the NuttX tools repository.
#

config ETHERCAT_SOEM_SIMPLETEST
	tristate "ETHERCAT SOEM SIMPLETEST"
	default n
	---help---
		ETHERCAT SOEM SIMPLETEST Program

if ETHERCAT_SOEM_SIMPLETEST

config ETHERCAT_SOEM_SIMPLETEST_PROGNAME
	string "Program name"
	default "simpletest"
	---help---
		This is the name of the program that will be used when the NSH ELF
		program is installed.

config ETHERCAT_SOEM_SIMPLETEST_PRIORITY
	int "SOEM SIMPLETEST Program task priority"
	default 128

config ETHERCAT_SOEM_SIMPLETEST_STACKSIZE
	int "SOEM SIMPLETEST Program stack size"
	default DEFAULT_TASK_STACKSIZE

endif
```
