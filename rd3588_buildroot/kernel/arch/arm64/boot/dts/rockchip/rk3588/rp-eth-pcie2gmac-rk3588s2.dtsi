&combphy0_ps { 
    status = "okay"; 
};

&pcie2x1l2 {
    phys = <&combphy0_ps PHY_TYPE_PCIE>;
    //vpcie3v3-supply = <&vcc3v3_pcie30>;
    reset-gpios = <&gpio3 RK_PD1 GPIO_ACTIVE_HIGH>;
	rp_rst_delay=<1500>; 
    status = "okay";
};


&pcie2x1l1 {
    reset-gpios = <&gpio1 RK_PA7 GPIO_ACTIVE_HIGH>;
    //vpcie3v3-supply = <&vcc3v3_pcie20>;
	rp_rst_delay=<0>;
    status = "okay";
};

&combphy2_psu {
    status = "okay";
};
