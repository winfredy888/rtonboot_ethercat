
/ {
        pcie20_avdd0v85: pcie20-avdd0v85 {
                compatible = "regulator-fixed";
                regulator-name = "pcie20_avdd0v85";
                regulator-boot-on;
                regulator-always-on;
                regulator-min-microvolt = <850000>;
                regulator-max-microvolt = <850000>;
                vin-supply = <&vdd_0v85_s0>;
        };

        pcie20_avdd1v8: pcie20-avdd1v8 {
                compatible = "regulator-fixed";
                regulator-name = "pcie20_avdd1v8";
                regulator-boot-on;
                regulator-always-on;
                regulator-min-microvolt = <1800000>;
                regulator-max-microvolt = <1800000>;
                vin-supply = <&avcc_1v8_s0>;
        };

        vcc3v3_pcie30: vcc3v3-pcie30 {
                compatible = "regulator-fixed";
                regulator-name = "vcc3v3_pcie30";
                regulator-min-microvolt = <3300000>;
                regulator-max-microvolt = <3300000>;
                enable-active-high;
                gpios = <&gpio4 RK_PA5 GPIO_ACTIVE_HIGH>;
                startup-delay-us = <5000>;
                vin-supply = <&vcc12v_dcin>;
        };


};
