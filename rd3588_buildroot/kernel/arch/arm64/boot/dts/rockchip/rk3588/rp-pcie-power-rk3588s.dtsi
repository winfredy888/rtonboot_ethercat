
/ {

    combophy_avdd0v85: combophy-avdd0v85 {
        compatible = "regulator-fixed";
        regulator-name = "combophy_avdd0v85";
        regulator-boot-on;
        regulator-always-on;
        regulator-min-microvolt = <850000>;
        regulator-max-microvolt = <850000>;
        vin-supply = <&vdd_0v85_s0>;
    };

    combophy_avdd1v8: combophy-avdd1v8 {
        compatible = "regulator-fixed";
        regulator-name = "combophy_avdd1v8";
        regulator-boot-on;
        regulator-always-on;
        regulator-min-microvolt = <1800000>;
        regulator-max-microvolt = <1800000>;
        vin-supply = <&avcc_1v8_s0>;
    };
};
