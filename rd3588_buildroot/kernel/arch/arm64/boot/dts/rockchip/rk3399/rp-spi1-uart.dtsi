
&spi1 {
        status = "okay";
        spi_wk2xxx: spi_wk2xxx@0{
                status = "okay";
                compatible = "spi-wk2xxx";
                reg = <0>;
                spi-max-frequency = <10000000>;
                reset-gpio = <&gpio4 29 GPIO_ACTIVE_HIGH>;
                irq-gpio = <&gpio1 20 IRQ_TYPE_EDGE_FALLING>;
                cs-gpio = <&gpio1 10 GPIO_ACTIVE_HIGH>;
        };
};


&uart4 {
    status = "disabled";
};