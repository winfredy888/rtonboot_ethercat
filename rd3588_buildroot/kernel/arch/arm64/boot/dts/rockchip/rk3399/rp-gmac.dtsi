

/ {
    clkin_gmac: external-gmac-clock {
        compatible = "fixed-clock";
        clock-frequency = <125000000>;
        clock-output-names = "clkin_gmac";
        #clock-cells = <0>;
    };

};

&gmac {
    assigned-clocks = <&cru SCLK_RMII_SRC>;
    assigned-clock-parents = <&clkin_gmac>;
    clock_in_out = "input";
    phy-supply = <&vcc_lan>;
    phy-mode = "rgmii";
    pinctrl-names = "default";
    pinctrl-0 = <&rgmii_pins>;
    snps,reset-gpio = <&gpio3 RK_PB7 GPIO_ACTIVE_LOW>;
    snps,reset-active-low;
    snps,reset-delays-us = <0 10000 50000>;
    tx_delay = <0x28>;
    rx_delay = <0x11>;
    status = "okay";
};