

&can0 {
    compatible = "rockchip,rk3568-can-2.0";
    assigned-clocks = <&cru CLK_CAN0>;
    assigned-clock-rates = <150000000>;
    pinctrl-names = "default";
    pinctrl-0 = <&can0m0_pins>;
    status = "okay";
};

&i2c1 {
    /** disabled for used to be can0 */
    status = "disabled";
};
