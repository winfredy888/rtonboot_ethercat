

&can1 {
         compatible = "rockchip,rk3568-can-2.0";
       assigned-clocks = <&cru CLK_CAN1>;
       assigned-clock-rates = <150000000>;
       pinctrl-names = "default";
       pinctrl-0 = <&can1m1_pins>;
       status = "okay";
};

