## rd3588_buildroot/buildroot/package/lib-rtsdk/Config.in
```kconfig
config BR2_PACKAGE_LIB_RTSDK
    bool "RTSDKLib static library"
    help
      This option enables building of RTSDKLib as a static library.
```

## rd3588_buildroot/kernel/drivers/media/platform_new/rockchip/Kconfig
```kconfig
# SPDX-License-Identifier: GPL-2.0

source "drivers/media/platform_new/rockchip/cif/Kconfig"
source "drivers/media/platform_new/rockchip/isp1/Kconfig"
source "drivers/media/platform_new/rockchip/isp/Kconfig"
source "drivers/media/platform_new/rockchip/ispp/Kconfig"
source "drivers/media/platform_new/rockchip/hdmirx/Kconfig"
```

## rd3588_buildroot/kernel/drivers/net/ethernet/yt6801/Kconfig
```kconfig
config YT6810
        tristate "YT6810 support"
        help
          Support for YT6810 chipset
```

## rd3588_buildroot/kernel/drivers/rtonboot/Kconfig
```kconfig
# SPDX-License-Identifier: GPL-2.0
menu "RTBridge"

config RTBRIDGE_DRIVER
	bool "RTOnBoot RTBridge Driver"
	depends on RTONBOOT_SUPPORT
	default n
	help
	  RTOnBoot RTBridge Driver.
	  
config RTBULK_DRIVER
	bool "RTOnBoot RTBULK Driver"
	depends on RTONBOOT_SUPPORT
	default n
	help
	  RTOnBoot RTBULK Driver.
	  
config RTONBOOT_VNETCARD_DRIVER
	bool "RTOnBoot Virtual NetCard Driver"
	depends on RTONBOOT_SUPPORT
	default n
	help
	  RTOnBoot Virtual NetCard Driver.	

endmenu
```

## rd3588_buildroot/kernel/kernel/rtonboot/Kconfig
```kconfig
menu "RTOnBoot features"

config RTONBOOT_SUPPORT
	bool "RTONBOOT SUPPORT"
	default n
	help
	RTONBOOT SUPPORT.

config RTONBOOT_CPUID
	int "RTONBOOT_CPUID"
	default 1
	range 1 8
	depends on RTONBOOT_SUPPORT
	help
	Define RTONBOOT_CPUID.
		
config RTONBOOT_ETHERCAT_SUPPORT
	bool "RTONBOOT_ETHERCAT_SUPPORT"
	default n
	depends on RTONBOOT_SUPPORT
	help
	RTONBOOT_ETHERCAT_SUPPORT.
	
source "drivers/rtonboot/Kconfig"	

endmenu
```

## rd3588_buildroot/u-boot/fit/u-boot.its
```
/*
 * Copyright (C) 2020 Rockchip Electronic Co.,Ltd
 *
 * Simple U-boot fit source file containing ATF/OP-TEE/U-Boot/dtb/MCU
 */

/dts-v1/;

/ {
	description = "FIT Image with ATF/OP-TEE/U-Boot/MCU";
	#address-cells = <1>;

	images {

		uboot {
			description = "U-Boot";
			data = /incbin/("u-boot-nodtb.bin");
			type = "standalone";
			arch = "arm64";
			os = "U-Boot";
			compression = "none";
			load = <0x00200000>;
			hash {
				algo = "sha256";
			};
		};
		atf-1 {
			description = "ARM Trusted Firmware";
			data = /incbin/("./bl31_0x00040000.bin");
			type = "firmware";
			arch = "arm64";
			os = "arm-trusted-firmware";
			compression = "none";
			load = <0x00040000>;
			hash {
				algo = "sha256";
			};
		};
		atf-2 {
			description = "ARM Trusted Firmware";
			data = /incbin/("./bl31_0xff100000.bin");
			type = "firmware";
			arch = "arm64";
			os = "arm-trusted-firmware";
			compression = "none";
			load = <0xff100000>;
			hash {
				algo = "sha256";
			};
		};
		atf-3 {
			description = "ARM Trusted Firmware";
			data = /incbin/("./bl31_0x000f0000.bin");
			type = "firmware";
			arch = "arm64";
			os = "arm-trusted-firmware";
			compression = "none";
			load = <0x000f0000>;
			hash {
				algo = "sha256";
			};
		};
		optee {
			description = "OP-TEE";
			data = /incbin/("tee.bin");
			type = "firmware";
			arch = "arm64";
			os = "op-tee";
			compression = "none";
			
			load = <0x8400000>;
			hash {
				algo = "sha256";
			};
		};
		fdt {
			description = "U-Boot dtb";
			data = /incbin/("./u-boot.dtb");
			type = "flat_dt";
			arch = "arm64";
			compression = "none";
			hash {
				algo = "sha256";
			};
		};
	};

	configurations {
		default = "conf";
		conf {
			description = "rk3588-evb";
			rollback-index = <0x0>;
			firmware = "atf-1";
			loadables = "uboot", "atf-2", "atf-3", "optee";
			
			fdt = "fdt";
			signature {
								algo = "sha256,rsa2048";
				
				key-name-hint = "dev";
				sign-images = "firmware", "loadables", "fdt";
			};
		};
	};
};
```
